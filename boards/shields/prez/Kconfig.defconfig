## boards/shields/prez/Kconfig.defconfig
```kconfig
if SHIELD_PREZ

config ZMK_KEYBOARD_NAME
    default "prez"

endif # SHIELD_PREZ
```

## boards/shields/the_pipe/Kconfig.defconfig
```kconfig
if SHIELD_THE_PIPE

config ZMK_KEYBOARD_NAME
    default "the-pipe"

endif # SHIELD_THE_PIPE
```

## boards/shields/zeus/Kconfig.defconfig
```kconfig
if SHIELD_ZEUS_LEFT

config ZMK_KEYBOARD_NAME
    default "Zeus"

config ZMK_SPLIT_ROLE_CENTRAL
    default y

endif # SHIELD_ZEUS_LEFT

if SHIELD_ZEUS_LEFT || SHIELD_ZEUS_RIGHT

config ZMK_SPLIT
    default y

endif # SHIELD_ZEUS_LEFT || SHIELD_ZEUS_RIGHT
```

## boards/shields/zeus/Kconfig.shield
```kconfig
config SHIELD_ZEUS_LEFT
    def_bool $(shields_list_contains,zeus_left)

config SHIELD_ZEUS_RIGHT
    def_bool $(shields_list_contains,zeus_right)
```
